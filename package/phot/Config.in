## package/phot/Config.in
```kconfig
config BR2_PACKAGE_PHOT
	bool "phot"
	select BR2_PACKAGE_PYTHON_TORNADO
	select BR2_PACKAGE_RCLONE
	help
	  Part of photoframe 
```

## package/photoframe-matrix/Config.in
```kconfig
config BR2_PACKAGE_PHOTOFRAME_MATRIX
	bool "photoframe-matrix"
	depends on BR2_PACKAGE_PHOTOFRAME
	select BR2_PACKAGE_LIBOLM
	select BR2_PACKAGE_PYTHON_PIP
	select BR2_PACKAGE_PYTHON_OLM
	select BR2_PACKAGE_PYTHON_MULTIDICT
	select BR2_PACKAGE_PYTHON_AIOHTTP
	select BR2_PACKAGE_PYTHON_ATTRS
	select BR2_PACKAGE_PYTHON_YARL
	select BR2_PACKAGE_PYTHON_MAUTRIX
	select BR2_PACKAGE_POSTGRESQL
	select BR2_PACKAGE_PYTHON_UNPADDEDBASE64
	select BR2_PACKAGE_PYTHON_PYCRYPTODOMEX
	select BR2_PACKAGE_PYTHON_SQLALCHEMY
	select BR2_PACKAGE_PYTHON_ASYNCPG
	select BR2_PYTHON_ASYNCPG_VERSION
	select BR2_PACKAGE_PYTHON_MATRIX_PHOTOS

	help
	  sync photos with the matrix.org open standard for secure, decentralised, real-time communication.
```

## package/photoframe/Config.in
```kconfig
config BR2_PACKAGE_PHOTOFRAME
	bool "photoframe"
	select BR2_PACKAGE_DAVFS2
	select BR2_PACKAGE_RSYNC
	select BR2_PACKAGE_FBV
	select BR2_PACKAGE_OMXPLAYER
	select BR2_PACKAGE_FILE
	help
	  Small photo frame app to show images from an dav storage onto
	  the framebuffer.
```

## package/python-matrix-photos/Config.in
```kconfig
config BR2_PACKAGE_PYTHON_MATRIX_PHOTOS
	bool "python-matrix-photos"
	select BR2_PACKAGE_PYTHON_MAUTRIX
	select BR2_PACKAGE_PYTHON_PYYAML
	help
	  Matrix client for photos

	  https://pypi.org/project/matrix-photos/
```

## package/python-mautrix/Config.in
```kconfig
config BR2_PACKAGE_PYTHON_MAUTRIX
	bool "python-mautrix"
	select BR2_PACKAGE_LIBOLM
	select BR2_PACKAGE_PYTHON_OLM
	select BR2_PACKAGE_PYTHON_MULTIDICT
	select BR2_PACKAGE_PYTHON_AIOHTTP
	select BR2_PACKAGE_PYTHON_ATTRS
	select BR2_PACKAGE_PYTHON_YARL

	help
	  A Python 3.8+ asyncio Matrix framework.

	  https://pypi.org/project/mautrix/
```

## package/python-olm/Config.in
```kconfig
config BR2_PACKAGE_PYTHON_OLM
	bool "python-olm"
	select BR2_PACKAGE_PYTHON_CFFI # runtime
	select BR2_PACKAGE_PYTHON_FUTURE # runtime
	select BR2_PACKAGE_PYTHON_TYPING # runtime
	help
	  python CFFI bindings for the olm cryptographic ratchet
	  library.

	  https://github.com/poljar/python-olm
```

## package/python-unpaddedbase64/Config.in
```kconfig
config BR2_PACKAGE_PYTHON_UNPADDEDBASE64
	bool "python-unpaddedbase64"
	help
	  Encode and decode Base64 without "=" padding.

	  https://github.com/matrix-org/python-unpaddedbase64
```

## package/rclone/Config.in
```kconfig
config BR2_PACKAGE_RCLONE
	bool "rclone"
	help
	  Command line program to manage files on cloud storage.
```

## package/thingos-webui/Config.in
```kconfig
config BR2_PACKAGE_THINGOS_WEBUI
	bool "thingos-webui"
	select BR2_PACKAGE_PYTHON_TORNADO
	help
	  Small web UI to control Raspberry Pi running thingOS

	  https://github.com/avanc/thingos-webui
```
